//#include "rk3568-kickpi-lcd-mipi0-10.1-800-1280.dtsi"
//#include "rk3568-kickpi-lcd-mipi1-10.1-800-1280.dtsi"
//#include "rk3568-kickpi-lcd-mipi0-10.1-800-1280-v2.dtsi"
#include "rk3568-kickpi-lcd-mipi1-10.1-800-1280-v2.dtsi"
//#include "rk3568-kickpi-lcd-mipi0-5-720-1280.dtsi"
//#include "rk3568-kickpi-lcd-mipi1-5-720-1280.dtsi"
#include "rk3568-kickpi-lcd-mipi0-8-800-1280.dtsi"
// #include "rk3568-kickpi-lcd-mipi1-8-800-1280.dtsi"


&dsi0_in_vp0 {
	status = "okay";
};

&dsi0_in_vp1 {
	status = "disabled";
};

 &route_dsi0 {
        status = "okay";
        connect = <&vp0_out_dsi0>;
 };
// // TRIPLE PANEL 
// &vop {
//     assigned-clocks = <&cru DCLK_VOP0>, <&cru DCLK_VOP1>, <&cru DCLK_VOP2>;
//     assigned-clock-parents = <&cru PLL_HPLL>, <&cru PLL_VPLL>, <&cru PLL_GPLL>;
// };